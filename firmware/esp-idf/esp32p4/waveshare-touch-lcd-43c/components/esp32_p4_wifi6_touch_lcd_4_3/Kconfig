## firmware/esp-idf/esp32p4/waveshare-touch-lcd-43c/components/esp32_p4_wifi6_touch_lcd_4_3/Kconfig
```kconfig
menu "Board Support Package"

    config BSP_ERROR_CHECK
        bool "Error check"
        default y

    config BSP_I2C_NUM
        int "I2C peripheral index"
        default 1

    config BSP_I2C_FAST_MODE
        bool "Enable I2C fast mode"
        default y

    config BSP_I2C_CLK_SPEED_HZ
        int "I2C clock speed (Hz)"
        default 400000 if BSP_I2C_FAST_MODE
        default 100000

    config BSP_DISPLAY_BRIGHTNESS_LEDC_CH
        int "LEDC channel index"
        default 1

    choice BSP_LCD_COLOR_FORMAT
        prompt "LCD color format"
        default BSP_LCD_COLOR_FORMAT_RGB565
        help
            Select LCD color format.

        config BSP_LCD_COLOR_FORMAT_RGB565
            bool "RGB565"
        config BSP_LCD_COLOR_FORMAT_RGB888
            bool "RGB888"
    endchoice

    config BSP_LCD_DPI_BUFFER_NUMS
        int "Set number of frame buffers"
        default 3

endmenu
```

## firmware/esp-idf/esp32s3/atk-dnesp32s3/sdkconfig.defaults
```kconfig
CONFIG_IDF_TARGET="esp32s3"
CONFIG_ESP_DEFAULT_CPU_FREQ_MHZ_240=y

# TiRTC SDK 2.5.0 build contract.
CONFIG_FREERTOS_HZ=1000
# CONFIG_FREERTOS_USE_TRACE_FACILITY is not set
# CONFIG_FREERTOS_USE_STATS_FORMATTING_FUNCTIONS is not set
# CONFIG_FREERTOS_GENERATE_RUN_TIME_STATS is not set

CONFIG_ESP_MAIN_TASK_STACK_SIZE=8192
CONFIG_PTHREAD_TASK_STACK_SIZE_DEFAULT=8192

# ATK-DNESP32S3 的下载/调试口使用 CH340C UART0。
CONFIG_ESP_CONSOLE_UART_DEFAULT=y
CONFIG_ESP_CONSOLE_SECONDARY_NONE=y

# 默认硬件基线：ESP32-S3 N16R8。其他 Flash/PSRAM 规格需要同步调整。
CONFIG_ESPTOOLPY_FLASHSIZE_16MB=y
CONFIG_ESPTOOLPY_FLASHSIZE="16MB"
CONFIG_PARTITION_TABLE_CUSTOM=y
CONFIG_PARTITION_TABLE_CUSTOM_FILENAME="partitions.csv"
CONFIG_PARTITION_TABLE_FILENAME="partitions.csv"

CONFIG_SPIRAM=y
CONFIG_SPIRAM_MODE_OCT=y
CONFIG_SPIRAM_TYPE_AUTO=y
CONFIG_SPIRAM_SPEED_80M=y
CONFIG_SPIRAM_USE_MALLOC=y
CONFIG_SPIRAM_MEMTEST=y
CONFIG_SPIRAM_MALLOC_RESERVE_INTERNAL=131072

CONFIG_SCCB_HARDWARE_I2C_DRIVER_NEW=y
CONFIG_SCCB_HARDWARE_I2C_PORT1=y
# CONFIG_CAMERA_CORE0 is not set
CONFIG_CAMERA_CORE1=y

# 平台 HTTP/MQTT、TiRTC 和证书校验所需网络/TLS 能力。
CONFIG_ESP_WIFI_TASK_PINNED_TO_CORE_0=y
# CONFIG_ESP_WIFI_TASK_PINNED_TO_CORE_1 is not set
CONFIG_LWIP_MAX_SOCKETS=16
CONFIG_MBEDTLS_TLS_SERVER_AND_CLIENT=y
CONFIG_MBEDTLS_SSL_PROTO_TLS1_2=y
CONFIG_MBEDTLS_AES_C=y
CONFIG_MBEDTLS_DES_C=y
CONFIG_MBEDTLS_SHA1_C=y
CONFIG_MBEDTLS_ECP_C=y
CONFIG_MBEDTLS_ECDH_C=y
CONFIG_MBEDTLS_ECDSA_C=y
CONFIG_MBEDTLS_CERTIFICATE_BUNDLE=y
```

## platforms/esp-idf/components/starter_tirtc/Kconfig
```kconfig
menu "XiaoTai development diagnostics"
config STARTER_PIPELINE_DIAGNOSTICS
    bool "Build optional media pipeline diagnostics"
    default y
    help
        Fixed-size counters for SDK submissions/callbacks and lwIP calls.
        Runtime collection is OFF at boot; enable with media-diag on.
        Disable this option to remove diagnostics and socket wrappers in production.
endmenu
```

## platforms/esp-idf/main/Kconfig.projbuild
```kconfig
menu "XiaoTai application"
config STARTER_AI_UPLINK_G711A
    bool
    default y
    help
        Product AI profile: A-law 8 kHz uplink, Opus 16 kHz downlink.
        Capture/AEC keep the board's existing 16 kHz processing domain.

config STARTER_AI_UPLINK_G711A_16K
    bool "AI A-law uplink at 16 kHz (server trial)"
    depends on STARTER_AI_UPLINK_G711A
    default n
    help
        Send the 16 kHz AEC output directly as A-law on AI sessions.
        The AI server must accept alaw/16000/1. Other sessions stay at 8 kHz.

config XIAOTAI_DISCOVERY_URL
    string "ThingConnect service discovery URL"
    default "http://ep-open.tangeopen.com/services"
    help
        Existing development endpoint is retained. Override for your deployment.
        HTTPS requires valid time, trusted certificates and sufficient TLS memory.
config XIAOTAI_WAKE_THRESHOLD_MILLI
    int "Voicute wake threshold (thousandths)"
    range 50 990
    default 700
    help
        Model-specific; requires acoustic validation. Console overrides are volatile.
endmenu
```
